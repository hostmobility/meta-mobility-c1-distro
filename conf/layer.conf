## conf/layer.conf
```bitbake
# We have a conf and classes directory, add to BBPATH
BBPATH .= ":${LAYERDIR}"

# We have recipes-* directories, add to BBFILES
BBFILES += "${LAYERDIR}/recipes-*/*/*.bb \
            ${LAYERDIR}/recipes-*/*/*.bbappend"

BBFILE_COLLECTIONS += "meta-mobility-c1-distro "
BBFILE_PATTERN_meta-mobility-c1-distro  = "^${LAYERDIR}/"
BBFILE_PRIORITY_meta-mobility-c1-distro = "92"

BBFILES_DYNAMIC += "\
  variscite-bsp:${LAYERDIR}/dynamic-layers/variscite-bsp/recipes-kernel/linux/linux-variscite_%.bbappend \
 "

LAYERDEPENDS_meta-mobility-c1-distro = "core"
LAYERSERIES_COMPAT_meta-mobility-c1-distro = "kirkstone mickledore"
```
